## config/boards/shields/rev53/Kconfig.defconfig
```kconfig
# Copyright (c) 2020 The ZMK Contributors
# SPDX-License-Identifier: MIT

if SHIELD_REV53

config ZMK_KEYBOARD_NAME
    default "rev53"

endif # SHIELD_REV53

if ZMK_BACKLIGHT

config PWM
    default y

config LED_PWM
    default y

endif # ZMK_BACKLIGHT
```
